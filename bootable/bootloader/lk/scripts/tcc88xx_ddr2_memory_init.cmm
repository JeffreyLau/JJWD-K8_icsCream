// TCC88xx Memory setting....
// CPU: 600Mhz , BUS: 300Mhz, ddr2 256


local &i &j

d.s 0xF0403014 %L 0x00000100 //REMAP to IRAM
d.s 0xF0400000 %L 0x002FFFF4 //CLK0_XI
d.s 0xF0400008 %L 0x002F1F14 //CLK2_XI
d.s 0xF040001C %L 0x002F1F14 //CLK4_XI

d.s 0xF0400020 %L 0x00012C03 //PLL_PWROFF
d.s 0xF0400020 %L 0x41016803 //PMS_720M
d.s 0xF0400020 %L 0xC1012C03 //PLL_PWRON

d.s 0xF0400024 %L 0x00012C03 //PLL3_PWROFF
d.s 0xF0400024 %L 0x4100A503 //PMS_660M
d.s 0xF0400024 %L 0xC000A503 //PLL3_PWRON

d.s 0xF0400000 %L 0x002ffff0 //COREBUS
d.s 0xF0400008 %L 0x00200013 //MEMBUS
d.s 0xF040001C %L 0x00200030 //SMUBUS

//ddr2
d.s 0xF0303020 %L 0x0005010a //EMCCFG

&i=0.
while &i<6400.
(
    &i=&i+1
)

d.s 0xF0303024 %L 0x00000200 //PHYCFG
d.s 0xF0306044 %L 0x00000720
d.s 0xF0306044 %L 0x00000722 //zq start

&i=0.
&j=0xF0306040
while &i==0. 	// Wait until ZQ End
(
    &i=data.long(R:&j)
    &i=&i&0x10000
)

d.s 0xF0306018 %L 0x0010100A //PHY Control0
d.s 0xF030601C %L 0xE0000086 //PHY Control1
d.s 0xF0306020 %L 0x00000000 //PHY Control2
d.s 0xF0306024 %L 0x00000000 //PHY Control3
d.s 0xF0306018 %L 0x0010100B //PHY Control0

&i=0.
&j=0xF0306040
while &i==0. 	// Wait until FLOCK == 1
(
    &i=data.long(R:&j)
    &i=&i&0x07
)

//PHY Control1
d.s 0xF030601C %L 0xE000008E //resync = 1
d.s 0xF030601C %L 0xE0000086 //resync = 0
d.s 0xF0306000 %L 0x30FF2088
d.s 0xF0306000 %L 0x30FF2098 //Enable Out of order scheduling
d.s 0xF0306004 %L 0x00202400 //MEMCTRL
d.s 0xF0306008 %L 0x40F01313 //MEMCHIP0
d.s 0xF0306014 %L 0x00000000 //PRECONFIG
d.s 0xF0306028 %L 0xFFFF00FF //PRECONFIG
d.s 0xF0306030 %L 0x00000924 //tAREF
d.s 0xF0306034 %L 0x3C4554CE //tROW
d.s 0xF0306038 %L 0x35350405 //tDATA
d.s 0xF030603C %L 0x19C80232 //tPWR

//Direct Command
d.s 0xF0306010 %L 0x07000000 //NOP
d.s 0xF0306010 %L 0x01000000 //precharge all
d.s 0xF0306010 %L 0x05000000 //AREF
d.s 0xF0306010 %L 0x07000000 //NOP
d.s 0xF0306010 %L 0x00020000
d.s 0xF0306010 %L 0x00030000
d.s 0xF0306010 %L 0x00000952
d.s 0xF0306010 %L 0x00010004
d.s 0xF0306010 %L 0x05000000 //AREF
d.s 0xF0303020 %L 0x0007010a //EMCCFG
d.s 0xF0306000 %L 0x30FF20B8
