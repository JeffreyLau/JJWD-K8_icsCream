//===========================================================================
//
//                       ANDROID TRACE32 CMM FILE
//
//                        EDIT HISTORY FOR MODULE
//
//---------------------------------------------------------------------------
// version     who      history
//---------------------------------------------------------------------------
// 110407-1   Bruce     Create file
//===========================================================================


	ENTRY &chipset

	TrOnchip.Set DABORT OFF
	TrOnchip.Set PABORT OFF
	TrOnchip.Set UNDEF OFF

	if "&chipset"=="TCC88xx"
	(
		sys.cpu cortexa8
		system.option rb on
		system.option.mmu off
		system.option dacr on
		system.option.enreset off
		system.option.trst on
		system.jtagclock 10mhz
		
		SYStem.MultiCore MEMORYACCESSPORT	0x0
		SYStem.MultiCore DEBUGACCESSPORT	0x1
		SYStem.MultiCore COREBASE		0x80007000  ; ARM core
		SYStem.MultiCore ETBBASE		0x80001000  ; ETB
		SYStem.MultiCore ETMBASE		0x80008000  ; ETM
		SYStem.MultiCore FUNNELBASE		0x80004000  ; FUNNEL 
	)
	else if "&chipset"=="TCC93xx"
	(
		SYStem.CPU arm1176jzf
		SYStem.Option mmu off
		SYStem.Option dacr on
		SYS.JTAGCLOCK RTCK
		SYS.OPTION TRST ON
		SYS.OPTION RESBREAK OFF
		SYS.OPTION ENRESET off
		SYS.OPTION WAITRESET ON
		
		//SETUP.IMASKASM ON              ; lock interrupts while single stepping
		//SETUP.IMASKHLL ON              ; lock interrupts while single stepping
	)
	else if "&chipset"=="TCC89xx"
	(
		SYStem.CPU arm1176jzf
		SYStem.Option mmu off
		SYStem.Option dacr on
		SYS.JTAGCLOCK RTCK
		SYS.OPTION TRST ON
		SYS.OPTION RESBREAK OFF
		SYS.OPTION ENRESET ON
		SYS.OPTION WAITRESET ON
	)
	else if "&chipset"=="TCC92xx"
	(
		SYStem.CPU arm1176jzf
		SYStem.Option mmu off
		SYStem.Option dacr on
		SYS.JTAGCLOCK RTCK
		SYS.OPTION TRST ON
		SYS.OPTION RESBREAK OFF
		SYS.OPTION ENRESET ON
		SYS.OPTION WAITRESET ON
	)
	else if "&chipset"=="TCC892x"
	(
		sys.cpu cortexa5
		system.option rb on
		system.option.mmu off
		system.option dacr on
		system.option.enreset off
		system.option.trst on
		system.jtagclock 10mhz

		SYStem.MultiCore MEMORYACCESSPORT 0x0
		SYStem.MultiCore DEBUGACCESSPORT  0x0
		SYStem.MultiCore COREBASE         0x80110000  ; ARM core
//		SYStem.MultiCore MEMORYACCESSPORT 0x0
//		SYStem.MultiCore DEBUGACCESSPORT  0x1
//		SYStem.MultiCore COREBASE         0x78100000  ; ARM core
//		SYStem.MultiCore ETBBASE          0x78001000  ; ETB
//		SYStem.MultiCore ETMBASE          0x7811C000  ; ETM
//		SYStem.MultiCore FUNNELBASE       0x78004000  ; FUNNEL 
	)
	else
	(
		print "Chipset is not selected correctly!"
	)

	print "chipset setting - &chipset"

enddo
//----------------------------------------------------------






